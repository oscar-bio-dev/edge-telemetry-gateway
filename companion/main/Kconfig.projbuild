## companion/main/Kconfig.projbuild
```kconfig
menu "Edge Companion (C6) Configuration"

    config ESPNOW_CHANNEL
        int "ESP-NOW Wi-Fi Channel"
        default 1
        range 1 14
        help
            Wi-Fi channel for ESP-NOW reception. Must match the channel
            configured on the sensor nodes (room-monitoring project).

    config ESPNOW_PMK
        string "Primary Master Key (PMK)"
        default "pmk1234567890123"
        help
            16-byte Primary Master Key. Must match exactly on both Node and Gateway.

    config ESPNOW_LMK
        string "Local Master Key (LMK)"
        default "lmk1234567890123"
        help
            16-byte Local Master Key used for CCMP encryption of ESP-NOW frames.

    config ESPNOW_TEST_NODE_MAC
        string "Test Node MAC Address (XX:XX:XX:XX:XX:XX)"
        default "AA:BB:CC:11:22:33"
        help
            MAC address of the sensor node used for laboratory testing.
            The Companion C6 will add this MAC as an encrypted peer on startup.

    config IPC_UART_BAUD_RATE
        int "IPC UART Baud Rate (Companion -> Host)"
        default 460800
        range 115200 2000000
        help
            Baud rate for the UART bus towards the ESP32-P4 host.

    config IPC_UART_TX_GPIO
        int "IPC UART TX GPIO (C6 -> P4)"
        default 20
        help
            C6 GPIO for UART TX towards P4. Default: GPIO20 (SDIO D0 trace).
            Connected to P4 GPIO14 via R19 on the Waveshare board.

    config IPC_UART_RX_GPIO
        int "IPC UART RX GPIO (C6 <- P4)"
        default 21
        help
            C6 GPIO for UART RX from P4. Default: GPIO21 (SDIO D1 trace).
            Connected to P4 GPIO15 via R18 on the Waveshare board.

    config HEARTBEAT_INTERVAL_MS
        int "Heartbeat Interval (ms)"
        default 10000
        range 1000 60000
        help
            Interval between heartbeat messages sent to the P4 host.

endmenu
```

## main/Kconfig.projbuild
```kconfig
menu "Edge Telemetry Gateway Configuration"

    config GCP_PROJECT_ID
        string "Google Cloud Project ID"
        default "setaesense-iot-core"
        help
            The Google Cloud project ID used for Pub/Sub publishing.
            Assembled at runtime into the Pub/Sub REST endpoint:
            https://pubsub.googleapis.com/v1/projects/<PROJECT_ID>/topics/<TOPIC>:publish

    config GCP_PUB_SUB_TOPIC
        string "Google Cloud Pub/Sub Topic"
        default "room-telemetry-topic"
        help
            The Pub/Sub topic name where telemetry data will be published.

    config GCP_PUB_SUB_DIAGNOSTICS_TOPIC
        string "Google Cloud Pub/Sub Diagnostics Topic"
        default "gateway-diagnostics-topic"
        help
            The Pub/Sub topic name where Gateway health and Degraded Mode
            alerts (e.g. MicroSD failure) are published.

    config SDCARD_LDO_CHANNEL
        int "MicroSD LDO Channel (PMU)"
        default 4
        range 1 5
        help
            The internal ESP32-P4 LDO channel that powers the MicroSD slot.
            Waveshare typically uses LDO 4 or 5 at 3.3V for the SD VDD.

    config IPC_UART_BAUD_RATE
        int "IPC UART Baud Rate (Host <-> Companion)"
        default 460800
        range 115200 2000000
        help
            Baud rate for the UART bus connecting the ESP32-P4 host
            to the ESP32-C6 companion. Default 460800 provides 4x
            margin with 51K series/pull-up resistors on the SDIO traces.

    config IPC_UART_TX_GPIO
        int "IPC UART TX GPIO (Host -> Companion)"
        default 15
        help
            P4 GPIO for UART TX towards C6. Default: GPIO15 (SDIO D1 trace).
            Connected to C6 GPIO21 via R18 on the Waveshare board.

    config IPC_UART_RX_GPIO
        int "IPC UART RX GPIO (Host <- Companion)"
        default 14
        help
            P4 GPIO for UART RX from C6. Default: GPIO14 (SDIO D0 trace).
            Connected to C6 GPIO20 via R19 on the Waveshare board.

    config COMPANION_RESET_GPIO
        int "Companion Reset GPIO (C6 EN/CHIP_PU)"
        default 54
        help
            P4 GPIO connected to C6 EN/CHIP_PU via R54 (0R).
            Used by esp-serial-flasher for Host-Driven OTA.

    config COMPANION_BOOT_GPIO
        int "Companion Boot GPIO (C6 IO2 strapping)"
        default 6
        help
            P4 GPIO connected to C6 IO2 via R52 (0R).
            Driven LOW during reset to enter C6 download mode for OTA.

    config ETH_PHY_ADDR
        int "Ethernet PHY Address (IP101GRI)"
        default 1
        range 0 31
        help
            MDIO address of the IP101GRI Ethernet PHY on the Waveshare board.

    config ETH_PHY_RST_GPIO
        int "Ethernet PHY Reset GPIO"
        default -1
        range -1 54
        help
            GPIO connected to PHY reset pin. Set -1 if not connected.

    config ETH_MDC_GPIO
        int "Ethernet MDC GPIO"
        default 31
        help
            GPIO for RMII MDC signal to IP101GRI PHY.

    config ETH_MDIO_GPIO
        int "Ethernet MDIO GPIO"
        default 52
        help
            GPIO for RMII MDIO signal to IP101GRI PHY.

    config TELEMETRY_QUEUE_SIZE
        int "Telemetry Queue Depth (max buffered samples)"
        default 64
        range 16 256
        help
            Number of decoded telemetry samples the ring buffer can hold.
            Sized for 50 nodes with margin. Each slot is ~64 bytes.

    config CLOUD_PUBLISH_BATCH_SIZE
        int "Cloud Publish Batch Size"
        default 10
        range 1 50
        help
            Number of telemetry samples to batch into a single
            Pub/Sub publish request. Reduces HTTP overhead.

    config COMPANION_HEARTBEAT_TIMEOUT_MS
        int "Companion Heartbeat Timeout (ms)"
        default 30000
        range 5000 120000
        help
            If no heartbeat is received from the C6 companion within
            this timeout, the watchdog triggers a recovery action.

    menu "Gateway Security & Crypto"

        config HW_ECDSA_ENABLE
            bool "Enable Hardware ECDSA_DS (Requires eFuse)"
            default n
            help
                If enabled, JWT signing will use the ESP32-P4 ECDSA_DS
                peripheral, which expects the private key to be burnt
                in an eFuse block.
                If disabled, a software fallback (mbedTLS) is used
                with a development key (dev_private_key.pem).

    endmenu

endmenu
```
